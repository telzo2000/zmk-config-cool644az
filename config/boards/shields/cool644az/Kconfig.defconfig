## config/boards/shields/cool644az/Kconfig.defconfig
```kconfig
if SHIELD_COOL644az_R

config ZMK_KEYBOARD_NAME
    default "cool644az_R"

config ZMK_SPLIT
    default y

config ZMK_SPLIT_ROLE_CENTRAL
    default y

config SPI
    default y

config ZMK_POINTING
    default y

config AZ1UBALL
    default y

config I2C
    default y
    
endif

if SHIELD_COOL644az_L

config ZMK_KEYBOARD_NAME
    default "cool644az_L"

config ZMK_SPLIT
    default y

endif
```

## config/boards/shields/cool644az/Kconfig.shield
```kconfig
config SHIELD_COOL644az_R
    def_bool $(shields_list_contains,cool644az_R)

config SHIELD_COOL644az_L
    def_bool $(shields_list_contains,cool644az_L)
```

## config/west.yml
```yaml
manifest:
  remotes:
    - name: zmkfirmware
      url-base: https://github.com/zmkfirmware
    - name: telzo2000
      url-base: https://github.com/telzo2000
    - name: pim447
      url-base: https://github.com/t0bybr/pim447
  projects:
    - name: zmk
      remote: zmkfirmware
      revision: main
      import: app/west.yml
    - name: pim447
      remote: pim447
      revision: main
      import: app/west.yml
  self:
    path: config
```
